## firmware-korvo/main/Kconfig.projbuild
```kconfig
menu "Korvo Wi-Fi Ethernet bridge"
    config BRIDGE_WIFI_SSID
        string "Default Wi-Fi SSID (optional)"
        default ""
    config BRIDGE_WIFI_PASSWORD
        string "Default Wi-Fi password (optional)"
        default ""
    config KORVO_LCD_ENABLED
        bool "Enable stock 800x480 touch display"
        default y
    config KORVO_USB_AUTO_CONFIGURATION
        bool "Discover Ethernet configurations automatically"
        default y
        help
            Inspect up to sixteen configurations and re-enumerate using ECM,
            NCM, RNDIS or a supported native chipset. No storage is mounted.
    config KORVO_USB_FORCE_FULL_SPEED
        bool "Force USB full-speed host mode (compatibility diagnostic)"
        default n
        help
            Limit the root bus to 12 Mbit/s. This can help full-speed adapters
            behind a high-speed hub when transaction translation is unavailable.
    config KORVO_USB_TRACE_CONTROL
        bool "Log every USB control request to serial and screen log"
        default n
    config KORVO_USB_CONFIGURATION
        int "USB bConfigurationValue to select"
        range 1 255
        default 1
        help
            Used when automatic configuration discovery is disabled.
endmenu
```

## firmware-korvo/sdkconfig.defaults
```kconfig
CONFIG_IDF_TARGET="esp32s31"
CONFIG_ESPTOOLPY_FLASHMODE_QIO=y
CONFIG_ESPTOOLPY_FLASHSIZE_16MB=y
CONFIG_PARTITION_TABLE_CUSTOM=y
CONFIG_PARTITION_TABLE_CUSTOM_FILENAME="partitions.csv"
CONFIG_COMPILER_OPTIMIZATION_PERF=y
CONFIG_SPIRAM=y
CONFIG_SPIRAM_SPEED_250M=y
CONFIG_SPIRAM_XIP_FROM_PSRAM=y
CONFIG_SPIRAM_TRY_ALLOCATE_WIFI_LWIP=y
CONFIG_SPIRAM_MALLOC_RESERVE_INTERNAL=65536
CONFIG_FREERTOS_HZ=1000
CONFIG_LWIP_MAX_SOCKETS=16
CONFIG_ESP_MAIN_TASK_STACK_SIZE=8192
CONFIG_LV_COLOR_DEPTH_16=y
CONFIG_LV_USE_CLIB_MALLOC=y
CONFIG_LV_USE_CLIB_STRING=y
CONFIG_LV_USE_CLIB_SPRINTF=y
CONFIG_LV_CACHE_DEF_SIZE=0
CONFIG_LV_FONT_MONTSERRAT_18=y
CONFIG_LV_DEF_REFR_PERIOD=33
CONFIG_BSP_LCD_DRAW_BUF_HEIGHT=60
CONFIG_BSP_LCD_RGB_BUFFER_NUMS=2
CONFIG_BSP_DISPLAY_LVGL_AVOID_TEAR=y
CONFIG_BSP_DISPLAY_LVGL_FULL_REFRESH=y
CONFIG_USB_HOST_CONTROL_TRANSFER_MAX_SIZE=4096
CONFIG_USB_HOST_ENABLE_ENUM_FILTER_CALLBACK=y
CONFIG_USB_HOST_HUBS_SUPPORTED=y
CONFIG_LV_FONT_MONTSERRAT_24=y
```
