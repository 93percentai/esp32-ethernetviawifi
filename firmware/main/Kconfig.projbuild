## firmware/main/Kconfig.projbuild
```kconfig
menu "USB Wi-Fi Bridge Configuration"

    config BRIDGE_WIFI_SSID
        string "Default WiFi SSID (optional compile-time seed)"
        default ""
        help
            Optional SSID baked into the firmware. Leave empty to provision at
            runtime: SoftAP captive portal (ESP_WIFITOUSB_CONF → http://192.168.1.1)
            or the USB CDC management console (set ssid / set pass / save).

    config BRIDGE_WIFI_PASSWORD
        string "Default WiFi Password"
        default ""
        help
            Optional WPA2/WPA3 passphrase for the compile-time default SSID.

    config BRIDGE_LCD_ENABLED
        bool "Enable ST7735 status LCD (T-Dongle-S3 with screen)"
        default y
        help
            Drive the 0.96" ST7735 IPS panel with Wi-Fi and traffic stats.

    config BRIDGE_STATUS_LED
        bool "Enable APA102 status LED"
        default y
        help
            Use the on-board APA102 RGB LED for association state.

    config BRIDGE_SD_BUS_WIDTH
        int "SD/MMC bus width (1 or 4)"
        range 1 4
        default 1
        help
            SDMMC data-line width for the hidden TF slot. 1-line is the most
            robust (fewer pins/pull-up constraints); 4-line is faster but needs
            D1-D3 wired and pulled up. The T-Dongle-S3 exposes CLK/CMD/D0-D3.

endmenu
```
